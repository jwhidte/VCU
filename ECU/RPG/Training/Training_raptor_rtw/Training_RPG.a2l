/************************************************
* ASAP2 file
* Generated by Raptor 1/30/2023 4:11:04 PM
* New Eagle, LLC 2012
* Machine: DESKTOP-1GSMJG8
* User : jackh
* OS : Microsoft Windows NT 6.2.9200.0
************************************************/ ASAP2_VERSION 1 51
/begin PROJECT Training_003
/*LongIdentifier (BUILD_UID) */ "MT02GY0s60iYwWMLa_u1Y"
/begin MODULE Training
/*LongIdentifier (XCPProdID) */ "20037"
/begin IF_DATA XCP
 /begin PROTOCOL_LAYER /* XCP protocol layer version */ 0x100 /* T1 [ms] */ 2000 /* T2 [ms] */ 2000 /* T3 [ms] */ 2000 /* T4 [ms] */ 2000 /* T5 [ms] */ 2000 /* T6 [ms] */ 0050 /* T7 [ms] */ 0050 /* MAX_CTO */ 8 /* MAX_DTO */ 8 /* BYTE_ORDER */ BYTE_ORDER_MSB_LAST /* ADDRESS_GRANULARITY */ ADDRESS_GRANULARITY_BYTE OPTIONAL_CMD SET_REQUEST OPTIONAL_CMD SET_MTA OPTIONAL_CMD UPLOAD OPTIONAL_CMD BUILD_CHECKSUM OPTIONAL_CMD TRANSPORT_LAYER_CMD OPTIONAL_CMD CLEAR_DAQ_LIST OPTIONAL_CMD SET_DAQ_PTR OPTIONAL_CMD WRITE_DAQ OPTIONAL_CMD SET_DAQ_LIST_MODE OPTIONAL_CMD START_STOP_DAQ_LIST OPTIONAL_CMD START_STOP_SYNCH OPTIONAL_CMD GET_DAQ_CLOCK OPTIONAL_CMD FREE_DAQ OPTIONAL_CMD ALLOC_DAQ OPTIONAL_CMD ALLOC_ODT OPTIONAL_CMD ALLOC_ODT_ENTRY OPTIONAL_CMD GET_SEED OPTIONAL_CMD UNLOCK OPTIONAL_CMD GET_DAQ_RESOLUTION_INFO OPTIONAL_CMD GET_DAQ_PROCESSOR_INFO OPTIONAL_CMD DOWNLOAD OPTIONAL_CMD GET_COMM_MODE_INFO
  /begin COMMUNICATION_MODE_SUPPORTED /begin BLOCK SLAVE MASTER /* MAX_BS */ 0xff /* MIN_ST */ 100 /end BLOCK /end COMMUNICATION_MODE_SUPPORTED
  SEED_AND_KEY_EXTERNAL_FUNCTION "raptor_XCPSecurity.dll" /end PROTOCOL_LAYER
 /begin DAQ /* DAQ_CONFIG_TYPE */ DYNAMIC /* MAX_DAQ */ 2 /* MAX_EVENT_CHANNEL */ 2 /* MIN_DAQ */ 0 /* OPTIMISATION_TYPE */ OPTIMISATION_TYPE_DEFAULT /* ADDRESS_EXTENSION */ ADDRESS_EXTENSION_DAQ /* IDENTIFICATION_FIELD */ IDENTIFICATION_FIELD_TYPE_ABSOLUTE /* GRANULARITY_ODT_ENTRY_SIZE_DAQ */ GRANULARITY_ODT_ENTRY_SIZE_DAQ_BYTE /* MAX_ODT_ENTRY_SIZE_DAQ */ 4 /* OVERLOAD_INDICATION */ NO_OVERLOAD_INDICATION
  /begin TIMESTAMP_SUPPORTED /* TIMESTAMP_TICKS */ 1 /* TIMESTAMP_SIZE */ SIZE_DWORD /* TIMESTAMP_RESOLUTION */ UNIT_1MS /end TIMESTAMP_SUPPORTED
  /begin EVENT /* EVENT_CHANNEL_NAME */ "List_10ms" /* EVENT_CHANNEL_SHORT_NAME */ "List_10ms" /* EVENT_CHANNEL_NUMBER */ 0 /* EVENT_CHANNEL_DIRECTION */ DAQ /* MAX_DAQ_LIST */ 20 /* TIME_CYCLE */ 10 /* TIME_UNIT */ 6 /* PRIORITY */ 0 /end EVENT
  /begin EVENT /* EVENT_CHANNEL_NAME */ "List_100ms" /* EVENT_CHANNEL_SHORT_NAME */ "List_100ms" /* EVENT_CHANNEL_NUMBER */ 1 /* EVENT_CHANNEL_DIRECTION */ DAQ /* MAX_DAQ_LIST */ 20 /* TIME_CYCLE */ 100 /* TIME_UNIT */ 6 /* PRIORITY */ 0 /end EVENT
 /end DAQ
 /begin XCP_ON_CAN /* XCP on CAN 1.0 */ 0x0100 /* auto-detection -- Bit31= 1: EXT */ CAN_ID_BROADCAST 0x100 /* CMD/STIM (master -> slave) -- Bit31= 1: EXT */ CAN_ID_MASTER 0x200 /* RES/ERR/EV/SERV/DAQ (slave -> master) -- Bit31= 1: EXT */ CAN_ID_SLAVE 0x300 /* In Hz */ BAUDRATE 500000 /* Percentage of complete bit time. */ SAMPLE_POINT 75 SAMPLE_RATE SINGLE /* Slots per bit time. */ BTL_CYCLES 0 /* Length of the synch segment. */ SJW 2 /* Sync Edge */ SYNC_EDGE SINGLE /end XCP_ON_CAN
/end IF_DATA
/begin MOD_PAR /* COMMENT */ "" ECU_CALIBRATION_OFFSET 0x00000000 ADDR_EPK 0x80037F45 EPK "MT02GY0s60iYwWMLa_u1Y"
 /begin MEMORY_SEGMENT CODE1 "Interrupt & Reset Vectors, Version Infos, Checksum Info" RESERVED FLASH INTERN 0x80000000 0x00020000 -1 -1 -1 -1 -1
  /begin IF_DATA XCP
   /begin SEGMENT 0 0x01 0x00 0x00 0x00 /begin CHECKSUM XCP_CRC_16_CITT /end CHECKSUM /end SEGMENT
  /end IF_DATA
 /end MEMORY_SEGMENT
 /begin MEMORY_SEGMENT BSW "BSW" CODE FLASH INTERN 0x80020000 0x00017E40 -1 -1 -1 -1 -1
  /begin IF_DATA XCP
   /begin SEGMENT 6 0x01 0x00 0x00 0x00 /begin CHECKSUM XCP_CRC_16_CITT /end CHECKSUM /end SEGMENT
  /end IF_DATA
 /end MEMORY_SEGMENT
 /begin MEMORY_SEGMENT EDIT_CALS "RAM Calibration Space" DATA FLASH INTERN 0x80037E40 0x00000028 -1 -1 -1 -1 -1
  /begin IF_DATA XCP
   /begin SEGMENT 1 0x01 0x00 0x00 0x00 /begin CHECKSUM XCP_CRC_16_CITT /end CHECKSUM /begin ADDRESS_MAPPING 0x80037E40 0xB00002C8 0x00000028 /end ADDRESS_MAPPING /end SEGMENT
  /end IF_DATA
 /end MEMORY_SEGMENT
 /begin MEMORY_SEGMENT EEPROM_CALS "Calibration Space" DATA EEPROM INTERN 0x80037E68 0x00000094 -1 -1 -1 -1 -1
  /begin IF_DATA XCP
   /begin SEGMENT 2 0x01 0x00 0x00 0x00 /begin CHECKSUM XCP_CRC_16_CITT /end CHECKSUM /begin ADDRESS_MAPPING 0x80037E68 0xB0000234 0x00000094 /end ADDRESS_MAPPING /end SEGMENT
  /end IF_DATA
 /end MEMORY_SEGMENT
 /begin MEMORY_SEGMENT ConstFLASH "Const FLASH Space" CODE FLASH INTERN 0x80037EFC 0x00000078 -1 -1 -1 -1 -1
  /begin IF_DATA XCP
   /begin SEGMENT 4 0x01 0x00 0x00 0x00 /begin CHECKSUM XCP_CRC_16_CITT /end CHECKSUM /end SEGMENT
  /end IF_DATA
 /end MEMORY_SEGMENT
 /begin MEMORY_SEGMENT CODE2 "Application Code" RESERVED FLASH INTERN 0x80037F74 0x001C808C -1 -1 -1 -1 -1
  /begin IF_DATA XCP
   /begin SEGMENT 5 0x01 0x00 0x00 0x00 /begin CHECKSUM XCP_CRC_16_CITT /end CHECKSUM /end SEGMENT
  /end IF_DATA
 /end MEMORY_SEGMENT
 /begin MEMORY_SEGMENT ASW2 "Application Code" CODE FLASH INTERN 0x80800000 0x00180000 -1 -1 -1 -1 -1
  /begin IF_DATA XCP
   /begin SEGMENT 7 0x01 0x00 0x00 0x00 /begin CHECKSUM XCP_CRC_16_CITT /end CHECKSUM /end SEGMENT
  /end IF_DATA
 /end MEMORY_SEGMENT
 /begin MEMORY_SEGMENT BSW_Cals "BSW Cals" DATA FLASH INTERN 0x80980000 0x0007C000 -1 -1 -1 -1 -1
  /begin IF_DATA XCP
   /begin SEGMENT 8 0x01 0x00 0x00 0x00 /begin CHECKSUM XCP_CRC_16_CITT /end CHECKSUM /end SEGMENT
  /end IF_DATA
 /end MEMORY_SEGMENT
 /begin MEMORY_SEGMENT MeasurmentRAM2 "Measurement Space2" VARIABLES RAM INTERN 0xB0000000 0x00020000 -1 -1 -1 -1 -1
  /begin IF_DATA XCP
   /begin SEGMENT 10 0x01 0x00 0x00 0x00 /begin CHECKSUM XCP_CRC_16_CITT /end CHECKSUM /end SEGMENT
  /end IF_DATA
 /end MEMORY_SEGMENT
 /begin MEMORY_SEGMENT MeasurmentRAM "Measurement Space" VARIABLES RAM INTERN 0xD0000000 0x00020000 -1 -1 -1 -1 -1
  /begin IF_DATA XCP
   /begin SEGMENT 9 0x01 0x00 0x00 0x00 /begin CHECKSUM XCP_CRC_16_CITT /end CHECKSUM /end SEGMENT
  /end IF_DATA
 /end MEMORY_SEGMENT
 /* 0x80000000 - 0x80020000 : CODE1 */ /* 0x80020000 - 0x80037E40 : BSW */ /* 0x80037E40 - 0x80037E68 : EDIT_CALS */ /* 0x80037E68 - 0x80037EFC : EEPROM_CALS */ /* 0x80037EFC - 0x80037F74 : ConstFLASH */ /* 0x80037F74 - 0x80200000 : CODE2 */ /* 0x80800000 - 0x80980000 : ASW2 */ /* 0x80980000 - 0x809FC000 : BSW_Cals */ /* 0xB0000000 - 0xB0020000 : MeasurmentRAM2 */ /* 0xD0000000 - 0xD0020000 : MeasurmentRAM */ /end MOD_PAR
/begin MOD_COMMON /* COMMENT */ "" BYTE_ORDER MSB_LAST ALIGNMENT_BYTE 1 ALIGNMENT_FLOAT32_IEEE 1 ALIGNMENT_FLOAT64_IEEE 1 ALIGNMENT_LONG 1 ALIGNMENT_WORD 1 /end MOD_COMMON
/begin RECORD_LAYOUT RECORD_LAYOUT__1 FNC_VALUES 1 FLOAT32_IEEE ROW_DIR DIRECT /end RECORD_LAYOUT
/begin RECORD_LAYOUT RECORD_LAYOUT__5 FNC_VALUES 1 SWORD ROW_DIR DIRECT /end RECORD_LAYOUT
/begin RECORD_LAYOUT RECORD_LAYOUT__2 FNC_VALUES 1 UBYTE ROW_DIR DIRECT /end RECORD_LAYOUT
/begin RECORD_LAYOUT RECORD_LAYOUT__3 FNC_VALUES 1 ULONG ROW_DIR DIRECT /end RECORD_LAYOUT
/begin RECORD_LAYOUT RECORD_LAYOUT__4 FNC_VALUES 1 UWORD ROW_DIR DIRECT /end RECORD_LAYOUT
/begin COMPU_METHOD COMPU_METHOD__8 "" RAT_FUNC "%10.5" "S" COEFFS 0 1 0 0 0 1 /end COMPU_METHOD
/begin COMPU_METHOD COMPU_METHOD__9 "" RAT_FUNC "%3.0" "" COEFFS 0 1 0 0 0 1 /end COMPU_METHOD
/begin COMPU_METHOD COMPU_METHOD__10 "" RAT_FUNC "%4.0" "" COEFFS 0 1 0 0 0 1 /end COMPU_METHOD
/begin COMPU_METHOD COMPU_METHOD__13 "" RAT_FUNC "%4.0" "ms" COEFFS 0 1 0 0 0 1 /end COMPU_METHOD
/begin COMPU_METHOD COMPU_METHOD__21 "" RAT_FUNC "%4.0" "NA" COEFFS 0 1 0 0 0 1 /end COMPU_METHOD
/begin COMPU_METHOD COMPU_METHOD__17 "" RAT_FUNC "%4.0" "Sec" COEFFS 0 1 0 0 0 0.1 /end COMPU_METHOD
/begin COMPU_METHOD COMPU_METHOD__4 "" RAT_FUNC "%5.0" "" COEFFS 0 1 0 0 0 1 /end COMPU_METHOD
/begin COMPU_METHOD COMPU_METHOD__1 "" RAT_FUNC "%5.0" "Bool" COEFFS 0 1 0 0 0 1 /end COMPU_METHOD
/begin COMPU_METHOD COMPU_METHOD__12 "" RAT_FUNC "%6.0" "cnt" COEFFS 0 1 0 0 0 1 /end COMPU_METHOD
/begin COMPU_METHOD COMPU_METHOD__22 "" RAT_FUNC "%6.2" "NA" COEFFS 0 1 0 0 0 0.00152588 /end COMPU_METHOD
/begin COMPU_METHOD COMPU_METHOD__7 "" RAT_FUNC "%7.0" "Counts" COEFFS 0 1 0 0 0 1 /end COMPU_METHOD
/begin COMPU_METHOD COMPU_METHOD__5 "" RAT_FUNC "%7.2" "" COEFFS 0 1 0 0 0 1 /end COMPU_METHOD
/begin COMPU_METHOD COMPU_METHOD__3 "" RAT_FUNC "%7.2" "ADC" COEFFS 0 1 0 0 0 1 /end COMPU_METHOD
/begin COMPU_METHOD COMPU_METHOD__2 "" RAT_FUNC "%7.2" "sec" COEFFS 0 1 0 0 0 1 /end COMPU_METHOD
/begin COMPU_METHOD COMPU_METHOD__23 "" RAT_FUNC "%7.3" "flag" COEFFS 0 1 0 0 0 1 /end COMPU_METHOD
/begin COMPU_METHOD COMPU_METHOD__16 "" TAB_VERB "%1.0" "" COMPU_TAB_REF COMPU_VTAB__5 /end COMPU_METHOD
/begin COMPU_METHOD COMPU_METHOD__6 "" TAB_VERB "%3.0" "" COMPU_TAB_REF COMPU_VTAB__1 /end COMPU_METHOD
/begin COMPU_METHOD COMPU_METHOD__24 "" TAB_VERB "%3.0" "" COMPU_TAB_REF COMPU_VTAB__9 /end COMPU_METHOD
/begin COMPU_METHOD COMPU_METHOD__18 "" TAB_VERB "%4.0" "" COMPU_TAB_REF COMPU_VTAB__6 /end COMPU_METHOD
/begin COMPU_METHOD COMPU_METHOD__19 "" TAB_VERB "%4.0" "" COMPU_TAB_REF COMPU_VTAB__7 /end COMPU_METHOD
/begin COMPU_METHOD COMPU_METHOD__20 "" TAB_VERB "%4.0" "" COMPU_TAB_REF COMPU_VTAB__8 /end COMPU_METHOD
/begin COMPU_METHOD COMPU_METHOD__11 "" TAB_VERB "%6.0" "" COMPU_TAB_REF COMPU_VTAB__2 /end COMPU_METHOD
/begin COMPU_METHOD COMPU_METHOD__14 "" TAB_VERB "%7.3" "" COMPU_TAB_REF COMPU_VTAB__3 /end COMPU_METHOD
/begin COMPU_METHOD COMPU_METHOD__15 "" TAB_VERB "%7.3" "" COMPU_TAB_REF COMPU_VTAB__4 /end COMPU_METHOD
/begin COMPU_VTAB COMPU_VTAB__8 "" TAB_VERB 11 0 "SWRESET_GRP_POWERON_E" 1 "SWRESET_GRP_HWRESET_E" 2 "SWRESET_GRP_WDT_E" 3 "SWRESET_GRP_WAKEUP_E" 4 "SWRESET_GRP_TRAP_E" 5 "SWRESET_GRP_SB_E" 6 "SWRESET_GRP_CB_E" 7 "SWRESET_SOFTRESETGRP_E" 8 "SWRESET_GRP_DUMMY_01" 9 "SWRESET_GRP_DUMMY_02" 10 "SWRESET_GRP_SYC_KL15RST_E" /end COMPU_VTAB
/begin COMPU_VTAB COMPU_VTAB__9 "" TAB_VERB 13 0 "Initialization" 1 "Loaded Defaults - Manual" 2 "Loaded Defaults - After Reprogramming" 3 "Loaded Defaults - Incorrect CRC" 4 "Loaded Defaults - Incorrect EE Format" 5 "Loaded Defaults - Error Reading EEPROM" 6 "Loaded Defaults - Failed Driver Initialization" 7 "Loaded Saved Values - After Reprogramming" 8 "Loaded Saved Values - Normal Startup" 9 "Loaded Saved Values - Backup Copy" 10 "Store In Progess" 11 "Store Attempt Failed" 12 "Store Succeeded" /end COMPU_VTAB
/begin COMPU_VTAB COMPU_VTAB__6 "" TAB_VERB 156 0 "SWRESET_POWERON_E" 1 "SWRESET_POWERON_WDT_E" 2 "SWRESET_POWERON_KL15_E" 3 "SWRESET_HW_E" 4 "SWRESET_WDT_E" 4096 "TRAP_MMU_VAF_E" 4097 "TRAP_MMU_VAP_E" 4098 "TRAP_INTPROT_PRIV_E" 4099 "TRAP_INTPROT_MPR_E" 4100 "TRAP_INTPROT_MPW_E" 4101 "TRAP_INTPROT_MPX_E" 4102 "TRAP_INTPROT_MPP_E" 4103 "TRAP_INTPROT_MPN_E" 4104 "TRAP_INTPROT_GRWP_E" 4105 "TRAP_INSTRERR_IOPC_E" 4106 "TRAP_INSTRERR_UOPC_E" 4107 "TRAP_INSTRERR_OPD_E" 4108 "TRAP_INSTRERR_ALN_E" 4109 "TRAP_INSTRERR_MEM_E" 4110 "TRAP_CONTMANA_FCD_E" 4111 "TRAP_CONTMANA_CDO_E" 4112 "TRAP_CONTMANA_CDU_E" 4113 "TRAP_CONTMANA_FCU_E" 4114 "TRAP_CONTMANA_CSU_E" 4115 "TRAP_CONTMANA_CTYP_E" 4116 "TRAP_CONTMANA_NEST_E" 4117 "TRAP_SYSBUSERR_PSE_E" 4118 "TRAP_SYSBUSERR_DSE_E" 4119 "TRAP_SYSBUSERR_DAE_E" 4120 "TRAP_SYSBUSERR_CAE_E" 4121 "TRAP_SYSBUSERR_PIE_E" 4122 "TRAP_SYSBUSERR_DIE_E" 4123 "TRAP_ASSTRAP_OVF_E" 4124 "TRAP_ASSTRAP_SOVF_E" 4125 "TRAP_SYSCALL_SYS_E" 4126 "TRAP_NMI_ESR0_E" 4127 "TRAP_NMI_ESR1_E" 4128 "TRAP_NMI_RES0_E" 4129 "TRAP_NMI_WDT_E" 4130 "TRAP_NMI_PE_E" 4131 "TRAP_NMI_OSCLWD_E" 4132 "TRAP_NMI_OSCHWD_E" 4133 "TRAP_NMI_OSCSPWD_E" 4134 "TRAP_NMI_SYSVCOLCK_E" 4135 "TRAP_NMI_ERAYVCOLCKT" 4136 "TRAP_NMI_FLOT_E" 4137 "TRAP_PE_P_IED_E" 4138 "TRAP_PE_P_IE_T_E" 4139 "TRAP_PE_P_IE_C_E" 4140 "TRAP_PE_P_IE_S_E" 4141 "TRAP_PE_P_IE_B_E" 4142 "TRAP_PE_D_IED_E" 4143 "TRAP_PE_D_IE_T_E" 4144 "TRAP_PE_D_IE_C_E" 4145 "TRAP_PE_D_IE_S_E" 4146 "TRAP_PE_D_IE_B_E" 4147 "TRAP_NMIPE_LDRAM_DSPR_E" 4148 "TRAP_NMIPE_DTAG_E" 4149 "TRAP_NMIPE_SPRAM_PSPR_E" 4150 "TRAP_NMIPE_PTAG_E" 4151 "TRAP_NMIPE_PMU_LMU_E" 4152 "TRAP_NMIPE_PRAM_E" 4153 "TRAP_NMIPE_CMEM_E" 4154 "TRAP_NMIPE_CAN_E" 4155 "TRAP_NMIPE_ERAY_E" 4156 "TRAP_NMIPE_SRI_E" 4157 "TRAP_NMIPE_EBU_E" 4158 "TRAP_NMIPE_BMU_E" 8192 "SWRESET_POWERON_SIMU_E" 8193 "SWRESET_HRESET_SIMU_E" 8194 "SWRESET_RB_PROG_E" 8195 "SWRESET_SOFTRESET_5VUNDERVOLTAGE_E" 8196 "SWRESET_SOFTRESET_POSTDRV2PREDRV_E" 8197 "SWRESET_CBPROG_E" 8198 "SWRESET_CBCPU_E" 8199 "SWRESET_RB_PROG_ILLEGAL_PATH_E" 8200 "SWRESET_TSW_EXIT_E" 8201 "SWRESET_TSW_HWTEST_FAIL_E" 8202 "SWRESET_TRPOT_FAIL_E" 8203 "SWRESET_OBD_SVC11_RESET_E" 8204 "SWRESET_SBDUMMY_6_E" 8205 "SWRESET_SBDUMMY_7_E" 8206 "SWRESET_SBDUMMY_8_E" 12288 "SWRST_EEPBANDGAP_E" 12289 "SWRST_EEPNODEBUGGER_E" 12290 "SWRST_EEPDELENVRAM_E" 12291 "SWRST_WRITE_ERRORS_SECTORCHANGE_E" 12292 "SWRST_EEPACTFIRSTINIT_E" 12293 "RESET_SWRESET_EPMHCRS_WAIT_PCP_RESET_E" 12294 "RESET_SWRESET_ESC_SCHED_RESET_E" 12295 "SWRST_EXECON_FAULTYSTATE_E" 12296 "RESET_SWRESET_ILLEGAL_OPCODE" 12297 "RESET_SWRESET_ILLEGAL_RETURN_TO_MAIN" 12298 "RESET_SWRESET_MEMLAY_MP_ACCESS" 12299 "SWRESET_MOCADCNTP_PREICO" 12300 "SWRESET_MOCADCTST_PREICO" 12301 "RESET_SWRESET_ILLEGAL_SW_PATH" 12302 "RESET_SWRESET_MOCCOM_SPI_ERROR" 12303 "RESET_SWRESET_MOCCOM_CTSOPTST" 12304 "RESET_SWRESET_MOCCOM_SOPTST" 12305 "RESET_SWRESET_MOCCOM_CPLCHK_FAILED" 12306 "RESET_SWRESET_MOCCOM_OS_TIMEOUT_ERROR" 12307 "RESET_SWRESET_MOCGPTA" 12308 "RESET_SWRESET_MOCMEM_CPLCHK_FAILED" 12309 "RESET_SWRESET_MOCMEM_CHKRAM_FAILED" 12310 "RESET_SWRESET_MOCMEM_CHKROM_FAILED" 12311 "RESET_SWRESET_MOCMEM_WTRAM_FAILED" 12312 "RESET_SWRESET_MOCMEM_WTROM_FAILED" 12313 "RESET_SWRESET_MOCPCP" 12314 "RESET_SWRESET_MOCRAM_WRI" 12315 "RESET_SWRESET_MOCRAM_CPL" 12316 "RESET_SWRESET_MOCRAM_RAMTAB" 12317 "RESET_SWRESET_MOCRAM_RSTPTRRAM" 12318 "RESET_SWRESET_MOCRAM_STACKRAM" 12319 "RESET_SWRESET_MOCRAM_CSARAM" 12320 "RESET_SWRESET_MOCRAM_XRAM" 12321 "RESET_SWRESET_MOCRAM_IRAM" 12322 "RESET_SWRESET_MOCRAM_EXRAM" 12323 "RESET_SWRESET_MOCRAM_PROTRAM" 12324 "RESET_SWRESET_MOCRAM_EEPCPL" 12325 "RESET_SWRESET_MOCRAM_REPEXOK" 12326 "RESET_SWRESET_MOCROM" 12327 "RESET_SWRESET_MOCROM_CPL" 12328 "RESET_SWRESET_MOCROM_INDEX" 12329 "RESET_SWRESET_SOPTEST_FAILED" 12330 "RESET_SWRESET_CPLCHK_FAILED" 12331 "RESET_SWRESET_MOCSOP_MSC_ERROR" 12332 "RESET_SWRESET_MOCSOP_SPI_ERROR" 12333 "RESET_SWRESET_MOCSOP_OS_TIMEOUT_ERROR" 12334 "RESET_SWRESET_MOCSOP_TIRESPTIME_ERROR" 12335 "SWRESET_OCWDA_WDA_ACTV" 12336 "SWRESET_OCWDA_WDA_MONITOR" 12337 "SWRESET_OCWDA_LOW_VLTG" 12338 "SWRESET_OCWDA_OVR_VLTG" 12339 "RESET_SWRESET_INTERRUPTLOCK_EXPECTED" 12340 "RESET_USERSTACKOVERFLOW_DETECTED" 12341 "SWRST_HWEMONDEFAULT_E" 12342 "RESET_ERRINTR_E" 12343 "SWRESET_CALWAKEUP_E" 12344 "SWRESET_DEADLINE1MS_E" 12345 "SWRESET_DEADLINE10MS_E" 12346 "SWRESET_DEADLINEBG_E" 12347 "SWRESET_NMIDISABLED_E" 12348 "SWRESET_POSTDRIVE_E" 12349 "SWRESET_UNEXPSYCSTSUB_E" 12350 "SWRESET_SOFTRESET_WAKEUP_E" 12351 "SWRESET_SOFTRESET_SHUTDOWN_E" 12352 "SWRESET_UNDERVOLTAGE_E" 12353 "RESET_SWRESET_SWOVER_DONE" 12354 "SWRESET_UNSUPPORTED_CPU_E" 12355 "SWRST_CAN_MESSAGECONFIG" 12356 "SWRST_ADCI_ERROR_E" 12357 "SWRST_PMD_PM_ERROR_E" 12358 "RESET_DMA_ERROR_E" 12359 "SWRST_FLASHCONFIG_E" 12360 "SWRESET_PCP_ERROR_E" /end COMPU_VTAB
/begin COMPU_VTAB COMPU_VTAB__2 "" TAB_VERB 2 0 "None" 20037 "Standard" /end COMPU_VTAB
/begin COMPU_VTAB COMPU_VTAB__1 "" TAB_VERB 2 0 "Pass Through" 1 "Override" /end COMPU_VTAB
/begin COMPU_VTAB COMPU_VTAB__4 "" TAB_VERB 2 -1 "(None)" 0 "ZeroETC_Duty_Cycle" /end COMPU_VTAB
/begin COMPU_VTAB COMPU_VTAB__5 "" TAB_VERB 3 0 "Normal Operation" 1 "Force Unsuspected" 2 "Force Suspected" /end COMPU_VTAB
/begin COMPU_VTAB COMPU_VTAB__3 "" TAB_VERB 5 0 "(None)" 1 "Not Occurred" 2 "Suspected" 4 "Active" 8 "Occurred" /end COMPU_VTAB
/begin COMPU_VTAB COMPU_VTAB__7 "" TAB_VERB 5 0 "OCWDA_CO_WDA_NOT_ACTV" -1802201964 "OCWDA_CO_WDA_OVRVLTG" -1431655766 "OCWDA_CO_WDA_ACTV" -1246382667 "OCWDA_CO_WDA_MONITOR" -943208505 "OCWDA_CO_WDA_LOWVLTG" /end COMPU_VTAB
/begin MEASUREMENT Absolute_Time "" FLOAT32_IEEE COMPU_METHOD__8 0 0 -1E+17 1E+17 ECU_ADDRESS 0xB00001FC /begin FUNCTION_LIST Foreground /end FUNCTION_LIST /end MEASUREMENT
/begin MEASUREMENT APP "" FLOAT32_IEEE COMPU_METHOD__5 0 0 -1E+17 1E+17 ECU_ADDRESS 0xB00001EC /begin FUNCTION_LIST Override_1_ /end FUNCTION_LIST /end MEASUREMENT
/begin MEASUREMENT APP_ADC "" UWORD COMPU_METHOD__4 0 0 0 65535 ECU_ADDRESS 0xB00001E8 /begin FUNCTION_LIST Override_1_ /end FUNCTION_LIST /end MEASUREMENT
/begin MEASUREMENT APPHighProbe "" UBYTE COMPU_METHOD__4 0 0 0 1 ECU_ADDRESS 0xB00001EA /begin FUNCTION_LIST Subsystem /end FUNCTION_LIST /end MEASUREMENT
/begin MEASUREMENT APPLowProbe "" UBYTE COMPU_METHOD__4 0 0 0 1 ECU_ADDRESS 0xB00001EB /begin FUNCTION_LIST Subsystem /end FUNCTION_LIST /end MEASUREMENT
/begin MEASUREMENT B_pwf "Power fail bit." UBYTE COMPU_METHOD__21 0 0 0 255 ECU_ADDRESS 0xD000001B /begin FUNCTION_LIST Platform /end FUNCTION_LIST /end MEASUREMENT
/begin MEASUREMENT CAN1_CANRX_QueueCount "Number of messages currently in CAN1 transmission queue." UBYTE COMPU_METHOD__12 0 0 0 100 ECU_ADDRESS 0xB0000208 /begin FUNCTION_LIST CAN /end FUNCTION_LIST /end MEASUREMENT
/begin MEASUREMENT CAN1_CANRX_QueueMax "Max number of messages seen in CAN1 transmission queue." UBYTE COMPU_METHOD__12 0 0 0 100 ECU_ADDRESS 0xB0000209 /begin FUNCTION_LIST CAN /end FUNCTION_LIST /end MEASUREMENT
/begin MEASUREMENT CAN1_CANRX_QueueOverrun "Number of times the CAN1 transmission queue has overrun." UBYTE COMPU_METHOD__12 0 0 0 255 ECU_ADDRESS 0xB0000207 /begin FUNCTION_LIST CAN /end FUNCTION_LIST /end MEASUREMENT
/begin MEASUREMENT CAN1_CANTX_QueueCount "Number of messages currently in CAN1 transmission queue." UBYTE COMPU_METHOD__12 0 0 0 100 ECU_ADDRESS 0xB0000205 /begin FUNCTION_LIST CAN /end FUNCTION_LIST /end MEASUREMENT
/begin MEASUREMENT CAN1_CANTX_QueueMax "Max number of messages seen in CAN1 transmission queue." UBYTE COMPU_METHOD__12 0 0 0 100 ECU_ADDRESS 0xB0000206 /begin FUNCTION_LIST CAN /end FUNCTION_LIST /end MEASUREMENT
/begin MEASUREMENT CAN1_CANTX_QueueOverrun "Number of times the CAN1 transmission queue has overrun." UBYTE COMPU_METHOD__12 0 0 0 255 ECU_ADDRESS 0xB0000204 /begin FUNCTION_LIST CAN /end FUNCTION_LIST /end MEASUREMENT
/begin MEASUREMENT ContextSaveAreaSize "Current % System Context Save Area Consumption." UWORD COMPU_METHOD__22 0 0 0 99.9985458 ECU_ADDRESS 0xD000951C /begin FUNCTION_LIST Platform /end FUNCTION_LIST /end MEASUREMENT
/begin MEASUREMENT Delta_Time "" FLOAT32_IEEE COMPU_METHOD__8 0 0 -1E+17 1E+17 ECU_ADDRESS 0xB00001F8 /begin FUNCTION_LIST Foreground /end FUNCTION_LIST /end MEASUREMENT
/begin MEASUREMENT EEPROM_State "EEPROM State on startup." UBYTE COMPU_METHOD__24 0 0 0 255 ECU_ADDRESS 0xB0000230 /begin FUNCTION_LIST System /end FUNCTION_LIST /end MEASUREMENT
/begin MEASUREMENT ETC_DC "" FLOAT32_IEEE COMPU_METHOD__5 0 0 -1E+17 1E+17 ECU_ADDRESS 0xB00001E4 /begin FUNCTION_LIST Override /end FUNCTION_LIST /end MEASUREMENT
/begin MEASUREMENT FgndTasksStopped "Boolean indicating foreground tasks stopped" UBYTE COMPU_METHOD__1 0 0 0 1 ECU_ADDRESS 0xB00001E1 /begin FUNCTION_LIST PowerUp_Down /end FUNCTION_LIST /end MEASUREMENT
/begin MEASUREMENT KeepModuleOn "Boolean indicating module to be kept on" UBYTE COMPU_METHOD__1 0 0 0 1 ECU_ADDRESS 0xB00001E3 /begin FUNCTION_LIST PowerUp_Down /end FUNCTION_LIST /end MEASUREMENT
/begin MEASUREMENT KeySw_Bgnd "Key switch reading from background task" UBYTE COMPU_METHOD__1 0 0 0 1 ECU_ADDRESS 0xB00001E2 /begin FUNCTION_LIST PowerUp_Down /end FUNCTION_LIST /end MEASUREMENT
/begin MEASUREMENT MaxContextSaveAreaSize "Maximum % System Context Save Area Consumption." UWORD COMPU_METHOD__22 0 0 0 99.9985458 ECU_ADDRESS 0xD0009522 /begin FUNCTION_LIST Platform /end FUNCTION_LIST /end MEASUREMENT
/begin MEASUREMENT MaxSystemStackSize "Maximum % System Stack Consumption." UWORD COMPU_METHOD__22 0 0 0 99.9985458 ECU_ADDRESS 0xD0009524 /begin FUNCTION_LIST Platform /end FUNCTION_LIST /end MEASUREMENT
/begin MEASUREMENT MaxUserStackSize "Maximum % User Stack Consumption." UWORD COMPU_METHOD__22 0 0 0 99.9985458 ECU_ADDRESS 0xD0009526 /begin FUNCTION_LIST Platform /end FUNCTION_LIST /end MEASUREMENT
/begin MEASUREMENT NumberOfResetsSincePowerOnReset "The number of resets since the last PowerOn Reset." UBYTE COMPU_METHOD__21 0 0 0 255 ECU_ADDRESS 0xD0001557 /begin FUNCTION_LIST Platform /end FUNCTION_LIST /end MEASUREMENT
/begin MEASUREMENT OCWDA_stWDAPtt "Status information for diagnosis module to report reason of WDA activation." ULONG COMPU_METHOD__19 0 0 0 255 ECU_ADDRESS 0xD000134C /begin FUNCTION_LIST Platform /end FUNCTION_LIST /end MEASUREMENT
/begin MEASUREMENT Reset_xHistBuf "Reset History." UWORD COMPU_METHOD__18 0 0 0 255 ECU_ADDRESS 0xD000D488 MATRIX_DIM 1 8 1 /begin FUNCTION_LIST Platform /end FUNCTION_LIST /end MEASUREMENT
/begin MEASUREMENT ResetGroupId "The last reset reason group id." UBYTE COMPU_METHOD__20 0 0 0 255 ECU_ADDRESS 0xD0001556 /begin FUNCTION_LIST Platform /end FUNCTION_LIST /end MEASUREMENT
/begin MEASUREMENT ResetReason "The last reset reason." UWORD COMPU_METHOD__18 0 0 0 65535 ECU_ADDRESS 0xD0001554 /begin FUNCTION_LIST Platform /end FUNCTION_LIST /end MEASUREMENT
/begin MEASUREMENT SystemStackSize "Current % System Stack Consumption." UWORD COMPU_METHOD__22 0 0 0 99.9985458 ECU_ADDRESS 0xD000951E /begin FUNCTION_LIST Platform /end FUNCTION_LIST /end MEASUREMENT
/begin MEASUREMENT TPS "" FLOAT32_IEEE COMPU_METHOD__5 0 0 -1E+17 1E+17 ECU_ADDRESS 0xB00001F4 /begin FUNCTION_LIST Override_2_ /end FUNCTION_LIST /end MEASUREMENT
/begin MEASUREMENT TPS_ADC "" UWORD COMPU_METHOD__4 0 0 0 65535 ECU_ADDRESS 0xB00001F0 /begin FUNCTION_LIST Override_2_ /end FUNCTION_LIST /end MEASUREMENT
/begin MEASUREMENT TPSHighProbe "" UBYTE COMPU_METHOD__4 0 0 0 1 ECU_ADDRESS 0xB00001F2 /begin FUNCTION_LIST Subsystem1 /end FUNCTION_LIST /end MEASUREMENT
/begin MEASUREMENT TPSLowProbe "" UBYTE COMPU_METHOD__4 0 0 0 1 ECU_ADDRESS 0xB00001F3 /begin FUNCTION_LIST Subsystem1 /end FUNCTION_LIST /end MEASUREMENT
/begin MEASUREMENT UserStackSize "Current % User Stack Consumption." UWORD COMPU_METHOD__22 0 0 0 99.9985458 ECU_ADDRESS 0xD0009520 /begin FUNCTION_LIST Platform /end FUNCTION_LIST /end MEASUREMENT
/begin CHARACTERISTIC APP_ADC_OvrSts "Controls status of value override." VALUE 0x80037E52 RECORD_LAYOUT__2 0 COMPU_METHOD__6 0 255 /begin FUNCTION_LIST Override_1_ /end FUNCTION_LIST /end CHARACTERISTIC
/begin CHARACTERISTIC APP_ADC_OvrVal "" VALUE 0x80037E50 RECORD_LAYOUT__4 0 COMPU_METHOD__4 0 65535 /begin FUNCTION_LIST Override_1_ /end FUNCTION_LIST /end CHARACTERISTIC
/begin CHARACTERISTIC APP_ADCHiPT "ADC High Point" VALUE 0x80037EA0 RECORD_LAYOUT__1 0 COMPU_METHOD__3 -1E+17 1E+17 /begin FUNCTION_LIST Subsystem /end FUNCTION_LIST /end CHARACTERISTIC
/begin CHARACTERISTIC APP_ADCLoPT "ADC Low Point" VALUE 0x80037EA4 RECORD_LAYOUT__1 0 COMPU_METHOD__3 -1E+17 1E+17 /begin FUNCTION_LIST Subsystem /end FUNCTION_LIST /end CHARACTERISTIC
/begin CHARACTERISTIC APP_DefaultValue "ADC Default Value" VALUE 0x80037E7C RECORD_LAYOUT__1 0 COMPU_METHOD__3 -1E+17 1E+17 /begin FUNCTION_LIST Subsystem /end FUNCTION_LIST /end CHARACTERISTIC
/begin CHARACTERISTIC APP_InputHi_Action_0 "Calibration for fault actions." VALUE 0x80037EE4 RECORD_LAYOUT__5 0 COMPU_METHOD__15 -32768 32767 /begin FUNCTION_LIST FaultManager /end FUNCTION_LIST /end CHARACTERISTIC
/begin CHARACTERISTIC APP_InputHi_Action_0_State "Calibration for fault actions." VALUE 0x80037EDC RECORD_LAYOUT__2 0 COMPU_METHOD__14 0 255 /begin FUNCTION_LIST FaultManager /end FUNCTION_LIST /end CHARACTERISTIC
/begin CHARACTERISTIC APP_InputHi_Action_1 "Calibration for fault actions." VALUE 0x80037EE6 RECORD_LAYOUT__5 0 COMPU_METHOD__15 -32768 32767 /begin FUNCTION_LIST FaultManager /end FUNCTION_LIST /end CHARACTERISTIC
/begin CHARACTERISTIC APP_InputHi_Action_1_State "Calibration for fault actions." VALUE 0x80037EDD RECORD_LAYOUT__2 0 COMPU_METHOD__14 0 255 /begin FUNCTION_LIST FaultManager /end FUNCTION_LIST /end CHARACTERISTIC
/begin CHARACTERISTIC APP_InputHi_FaultOperation "Calibration for testing fault." VALUE 0x80037EF4 RECORD_LAYOUT__2 0 COMPU_METHOD__16 0 8 /begin FUNCTION_LIST FaultManager /end FUNCTION_LIST /end CHARACTERISTIC
/begin CHARACTERISTIC APP_InputHi_X_Limit "Limit threshold for X." VALUE 0x80037E8C RECORD_LAYOUT__3 0 COMPU_METHOD__7 0 4294967295 /begin FUNCTION_LIST FaultManager /end FUNCTION_LIST /end CHARACTERISTIC
/begin CHARACTERISTIC APP_InputHi_Y_Limit "Limit threshold for Y." VALUE 0x80037E90 RECORD_LAYOUT__3 0 COMPU_METHOD__7 0 4294967295 /begin FUNCTION_LIST FaultManager /end FUNCTION_LIST /end CHARACTERISTIC
/begin CHARACTERISTIC APP_InputHighThresh "Input out of range high point threshold" VALUE 0x80037E88 RECORD_LAYOUT__1 0 COMPU_METHOD__3 -1E+17 1E+17 /begin FUNCTION_LIST Subsystem /end FUNCTION_LIST /end CHARACTERISTIC
/begin CHARACTERISTIC APP_InputLow_Action_0 "Calibration for fault actions." VALUE 0x80037EE8 RECORD_LAYOUT__5 0 COMPU_METHOD__15 -32768 32767 /begin FUNCTION_LIST FaultManager /end FUNCTION_LIST /end CHARACTERISTIC
/begin CHARACTERISTIC APP_InputLow_Action_0_State "Calibration for fault actions." VALUE 0x80037EDE RECORD_LAYOUT__2 0 COMPU_METHOD__14 0 255 /begin FUNCTION_LIST FaultManager /end FUNCTION_LIST /end CHARACTERISTIC
/begin CHARACTERISTIC APP_InputLow_Action_1 "Calibration for fault actions." VALUE 0x80037EEA RECORD_LAYOUT__5 0 COMPU_METHOD__15 -32768 32767 /begin FUNCTION_LIST FaultManager /end FUNCTION_LIST /end CHARACTERISTIC
/begin CHARACTERISTIC APP_InputLow_Action_1_State "Calibration for fault actions." VALUE 0x80037EDF RECORD_LAYOUT__2 0 COMPU_METHOD__14 0 255 /begin FUNCTION_LIST FaultManager /end FUNCTION_LIST /end CHARACTERISTIC
/begin CHARACTERISTIC APP_InputLow_FaultOperation "Calibration for testing fault." VALUE 0x80037EF5 RECORD_LAYOUT__2 0 COMPU_METHOD__16 0 8 /begin FUNCTION_LIST FaultManager /end FUNCTION_LIST /end CHARACTERISTIC
/begin CHARACTERISTIC APP_InputLow_X_Limit "Limit threshold for X." VALUE 0x80037E98 RECORD_LAYOUT__3 0 COMPU_METHOD__7 0 4294967295 /begin FUNCTION_LIST FaultManager /end FUNCTION_LIST /end CHARACTERISTIC
/begin CHARACTERISTIC APP_InputLow_Y_Limit "Limit threshold for Y." VALUE 0x80037E9C RECORD_LAYOUT__3 0 COMPU_METHOD__7 0 4294967295 /begin FUNCTION_LIST FaultManager /end FUNCTION_LIST /end CHARACTERISTIC
/begin CHARACTERISTIC APP_InputLowThresh "Input out of range low point threshold" VALUE 0x80037E94 RECORD_LAYOUT__1 0 COMPU_METHOD__3 -1E+17 1E+17 /begin FUNCTION_LIST Subsystem /end FUNCTION_LIST /end CHARACTERISTIC
/begin CHARACTERISTIC APP_OvrSts "Controls status of value override." VALUE 0x80037E58 RECORD_LAYOUT__2 0 COMPU_METHOD__6 0 255 /begin FUNCTION_LIST Override_1_ /end FUNCTION_LIST /end CHARACTERISTIC
/begin CHARACTERISTIC APP_OvrVal "" VALUE 0x80037E54 RECORD_LAYOUT__1 0 COMPU_METHOD__5 -1E+17 1E+17 /begin FUNCTION_LIST Override_1_ /end FUNCTION_LIST /end CHARACTERISTIC
/begin CHARACTERISTIC BuildNumber "Model build number." VALUE 0x80037F04 RECORD_LAYOUT__3 0 COMPU_METHOD__9 0 4294967295 READ_ONLY /end CHARACTERISTIC
/begin CHARACTERISTIC BuildUID "Unique build ID for this software." ASCII 0x80037F45 RECORD_LAYOUT__2 0 COMPU_METHOD__9 0 255 READ_ONLY MATRIX_DIM 21 1 1 /end CHARACTERISTIC
/begin CHARACTERISTIC CalIdTxt "Calibration ID for this Software Package." ASCII 0x80037F35 RECORD_LAYOUT__2 0 COMPU_METHOD__9 0 255 MATRIX_DIM 16 1 1 /end CHARACTERISTIC
/begin CHARACTERISTIC CAN1__XCP_BC_ID "CAN message ID used to identify XCP targets on the CAN bus. This should be the same for all ECUs on the CAN bus. This is how Raptor-Cal discovers ECUs on the CAN bus." VALUE 0x80037EC8 RECORD_LAYOUT__3 0 COMPU_METHOD__4 0 4294967295 /begin FUNCTION_LIST XCP /end FUNCTION_LIST /end CHARACTERISTIC
/begin CHARACTERISTIC CAN1__XCP_RX_ID "CAN message ID that the module will receive CMD and STIM commands from the calibration tool on." VALUE 0x80037ECC RECORD_LAYOUT__3 0 COMPU_METHOD__4 0 4294967295 /begin FUNCTION_LIST XCP /end FUNCTION_LIST /end CHARACTERISTIC
/begin CHARACTERISTIC CAN1__XCP_Security "Calibration to change XCP security, takes effect at next power-up." VALUE 0x80037ED6 RECORD_LAYOUT__4 0 COMPU_METHOD__11 0 65535 /begin FUNCTION_LIST XCP /end FUNCTION_LIST /end CHARACTERISTIC
/begin CHARACTERISTIC CAN1__XCP_TX_ID "CAN message ID that the module will send RES, ERR, EV, SERV and DAQ commands to the calibration tool on." VALUE 0x80037ED0 RECORD_LAYOUT__3 0 COMPU_METHOD__4 0 4294967295 /begin FUNCTION_LIST XCP /end FUNCTION_LIST /end CHARACTERISTIC
/begin CHARACTERISTIC CAN1_ErrorCheck_Interval "Frequency interval to check for CAN errors, 0 to disable." VALUE 0x80037EDA RECORD_LAYOUT__2 0 COMPU_METHOD__13 0 255 /begin FUNCTION_LIST CAN /end FUNCTION_LIST /end CHARACTERISTIC
/begin CHARACTERISTIC CAN1_ErrorPassive_Delay "Delay before restart after Error passive detected." VALUE 0x80037EDB RECORD_LAYOUT__2 0 COMPU_METHOD__13 0 255 /begin FUNCTION_LIST CAN /end FUNCTION_LIST /end CHARACTERISTIC
/begin CHARACTERISTIC CAN1_Startup_Delay "Delay before starting send/receive to allow bus conditions to settle out after powerup." VALUE 0x80037ED8 RECORD_LAYOUT__4 0 COMPU_METHOD__13 20 60000 /begin FUNCTION_LIST CAN /end FUNCTION_LIST /end CHARACTERISTIC
/begin CHARACTERISTIC DateStamp "Date and time the model was built." ASCII 0x80037F60 RECORD_LAYOUT__2 0 COMPU_METHOD__9 0 255 READ_ONLY MATRIX_DIM 20 1 1 /end CHARACTERISTIC
/begin CHARACTERISTIC EndOfStart "Indicates whether start is completed." VALUE 0x80037EF9 RECORD_LAYOUT__2 0 COMPU_METHOD__23 0 255 /begin FUNCTION_LIST Platform /end FUNCTION_LIST /end CHARACTERISTIC
/begin CHARACTERISTIC ETC_DC_OvrSts "Controls status of value override." VALUE 0x80037E48 RECORD_LAYOUT__2 0 COMPU_METHOD__6 0 255 /begin FUNCTION_LIST Override /end FUNCTION_LIST /end CHARACTERISTIC
/begin CHARACTERISTIC ETC_DC_OvrVal "" VALUE 0x80037E44 RECORD_LAYOUT__1 0 COMPU_METHOD__5 -1E+17 1E+17 /begin FUNCTION_LIST Override /end FUNCTION_LIST /end CHARACTERISTIC
/begin CHARACTERISTIC HardwareType "Hardware type for the target." VALUE 0x80037F5C RECORD_LAYOUT__3 0 COMPU_METHOD__9 0 4294967295 READ_ONLY /end CHARACTERISTIC
/begin CHARACTERISTIC IdTableRev "IdTableRev for the model (XCP device ids)." VALUE 0x80037F5A RECORD_LAYOUT__4 0 COMPU_METHOD__9 0 65535 READ_ONLY /end CHARACTERISTIC
/begin CHARACTERISTIC InjCDrv_EndOfStart "Indicates end of start for injection. Engine start is completed." VALUE 0x80037EF8 RECORD_LAYOUT__2 0 COMPU_METHOD__23 0 255 /begin FUNCTION_LIST Fuel /end FUNCTION_LIST /end CHARACTERISTIC
/begin CHARACTERISTIC INPUT29_ADCMon_HoldCount "Number of samples to hold after ADC monitor check." VALUE 0x80037ED4 RECORD_LAYOUT__2 0 COMPU_METHOD__10 0 255 /begin FUNCTION_LIST Platform /end FUNCTION_LIST /end CHARACTERISTIC
/begin CHARACTERISTIC KeySwHiTimeThr "State high time threshold" VALUE 0x80037E74 RECORD_LAYOUT__1 0 COMPU_METHOD__2 -1E+17 1E+17 /begin FUNCTION_LIST PowerUp_Down /end FUNCTION_LIST /end CHARACTERISTIC
/begin CHARACTERISTIC KeySwLoTimeThr "State low time threshold" VALUE 0x80037E78 RECORD_LAYOUT__1 0 COMPU_METHOD__2 -1E+17 1E+17 /begin FUNCTION_LIST PowerUp_Down /end FUNCTION_LIST /end CHARACTERISTIC
/begin CHARACTERISTIC MatlabVersion "Matlab version used for build." ASCII 0x80037F08 RECORD_LAYOUT__2 0 COMPU_METHOD__9 0 255 READ_ONLY MATRIX_DIM 13 1 1 /end CHARACTERISTIC
/begin CHARACTERISTIC ModelName "Name of model" ASCII 0x80037EFC RECORD_LAYOUT__2 0 COMPU_METHOD__9 0 255 READ_ONLY MATRIX_DIM 8 1 1 /end CHARACTERISTIC
/begin CHARACTERISTIC PWM_Enable "" VALUE 0x80037E84 RECORD_LAYOUT__2 0 COMPU_METHOD__4 0 1 /begin FUNCTION_LIST Actuators /end FUNCTION_LIST /end CHARACTERISTIC
/begin CHARACTERISTIC PWM_Freq "" VALUE 0x80037E4C RECORD_LAYOUT__3 0 COMPU_METHOD__4 0 4294967295 /begin FUNCTION_LIST Actuators /end FUNCTION_LIST /end CHARACTERISTIC
/begin CHARACTERISTIC RaptorVersion "Raptor version used for build." ASCII 0x80037F15 RECORD_LAYOUT__2 0 COMPU_METHOD__9 0 255 READ_ONLY MATRIX_DIM 20 1 1 /end CHARACTERISTIC
/begin CHARACTERISTIC SwIdTxt "Software name for this build." ASCII 0x80037F29 RECORD_LAYOUT__2 0 COMPU_METHOD__9 0 255 READ_ONLY MATRIX_DIM 12 1 1 /end CHARACTERISTIC
/begin CHARACTERISTIC SyC_tiPostDrvMax_C "Maximal time in PostDrive state with RPM equal to zero." VALUE 0x80983A6E RECORD_LAYOUT__4 0 COMPU_METHOD__17 0 4000 /begin FUNCTION_LIST Platform /end FUNCTION_LIST /end CHARACTERISTIC
/begin CHARACTERISTIC SyC_tiPostDrvMin_C "Minimum time in PostDrive state with RPM equal to zero." VALUE 0x80983A70 RECORD_LAYOUT__4 0 COMPU_METHOD__17 3 4000 /begin FUNCTION_LIST Platform /end FUNCTION_LIST /end CHARACTERISTIC
/begin CHARACTERISTIC SyC_tiPostDrvResv_C "Reserved time within SyC_PostDrvMax_C for DSM and EEPROM activities at the end of PostDrive." VALUE 0x80983A72 RECORD_LAYOUT__4 0 COMPU_METHOD__17 0 4000 /begin FUNCTION_LIST Platform /end FUNCTION_LIST /end CHARACTERISTIC
/begin CHARACTERISTIC TPS_ADC_OvrSts "Controls status of value override." VALUE 0x80037E5C RECORD_LAYOUT__2 0 COMPU_METHOD__6 0 255 /begin FUNCTION_LIST Override_2_ /end FUNCTION_LIST /end CHARACTERISTIC
/begin CHARACTERISTIC TPS_ADC_OvrVal "" VALUE 0x80037E5A RECORD_LAYOUT__4 0 COMPU_METHOD__4 0 65535 /begin FUNCTION_LIST Override_2_ /end FUNCTION_LIST /end CHARACTERISTIC
/begin CHARACTERISTIC TPS_ADCHiPT "ADC High Point" VALUE 0x80037EC0 RECORD_LAYOUT__1 0 COMPU_METHOD__3 -1E+17 1E+17 /begin FUNCTION_LIST Subsystem1 /end FUNCTION_LIST /end CHARACTERISTIC
/begin CHARACTERISTIC TPS_ADCLoPT "ADC Low Point" VALUE 0x80037EC4 RECORD_LAYOUT__1 0 COMPU_METHOD__3 -1E+17 1E+17 /begin FUNCTION_LIST Subsystem1 /end FUNCTION_LIST /end CHARACTERISTIC
/begin CHARACTERISTIC TPS_DefaultValue "ADC Default Value" VALUE 0x80037E80 RECORD_LAYOUT__1 0 COMPU_METHOD__3 -1E+17 1E+17 /begin FUNCTION_LIST Subsystem1 /end FUNCTION_LIST /end CHARACTERISTIC
/begin CHARACTERISTIC TPS_InputHi_Action_0 "Calibration for fault actions." VALUE 0x80037EEC RECORD_LAYOUT__5 0 COMPU_METHOD__15 -32768 32767 /begin FUNCTION_LIST FaultManager /end FUNCTION_LIST /end CHARACTERISTIC
/begin CHARACTERISTIC TPS_InputHi_Action_0_State "Calibration for fault actions." VALUE 0x80037EE0 RECORD_LAYOUT__2 0 COMPU_METHOD__14 0 255 /begin FUNCTION_LIST FaultManager /end FUNCTION_LIST /end CHARACTERISTIC
/begin CHARACTERISTIC TPS_InputHi_Action_1 "Calibration for fault actions." VALUE 0x80037EEE RECORD_LAYOUT__5 0 COMPU_METHOD__15 -32768 32767 /begin FUNCTION_LIST FaultManager /end FUNCTION_LIST /end CHARACTERISTIC
/begin CHARACTERISTIC TPS_InputHi_Action_1_State "Calibration for fault actions." VALUE 0x80037EE1 RECORD_LAYOUT__2 0 COMPU_METHOD__14 0 255 /begin FUNCTION_LIST FaultManager /end FUNCTION_LIST /end CHARACTERISTIC
/begin CHARACTERISTIC TPS_InputHi_FaultOperation "Calibration for testing fault." VALUE 0x80037EF6 RECORD_LAYOUT__2 0 COMPU_METHOD__16 0 8 /begin FUNCTION_LIST FaultManager /end FUNCTION_LIST /end CHARACTERISTIC
/begin CHARACTERISTIC TPS_InputHi_X_Limit "Limit threshold for X." VALUE 0x80037EAC RECORD_LAYOUT__3 0 COMPU_METHOD__7 0 4294967295 /begin FUNCTION_LIST FaultManager /end FUNCTION_LIST /end CHARACTERISTIC
/begin CHARACTERISTIC TPS_InputHi_Y_Limit "Limit threshold for Y." VALUE 0x80037EB0 RECORD_LAYOUT__3 0 COMPU_METHOD__7 0 4294967295 /begin FUNCTION_LIST FaultManager /end FUNCTION_LIST /end CHARACTERISTIC
/begin CHARACTERISTIC TPS_InputHighThresh "Input out of range high point threshold" VALUE 0x80037EA8 RECORD_LAYOUT__1 0 COMPU_METHOD__3 -1E+17 1E+17 /begin FUNCTION_LIST Subsystem1 /end FUNCTION_LIST /end CHARACTERISTIC
/begin CHARACTERISTIC TPS_InputLow_Action_0 "Calibration for fault actions." VALUE 0x80037EF0 RECORD_LAYOUT__5 0 COMPU_METHOD__15 -32768 32767 /begin FUNCTION_LIST FaultManager /end FUNCTION_LIST /end CHARACTERISTIC
/begin CHARACTERISTIC TPS_InputLow_Action_0_State "Calibration for fault actions." VALUE 0x80037EE2 RECORD_LAYOUT__2 0 COMPU_METHOD__14 0 255 /begin FUNCTION_LIST FaultManager /end FUNCTION_LIST /end CHARACTERISTIC
/begin CHARACTERISTIC TPS_InputLow_Action_1 "Calibration for fault actions." VALUE 0x80037EF2 RECORD_LAYOUT__5 0 COMPU_METHOD__15 -32768 32767 /begin FUNCTION_LIST FaultManager /end FUNCTION_LIST /end CHARACTERISTIC
/begin CHARACTERISTIC TPS_InputLow_Action_1_State "Calibration for fault actions." VALUE 0x80037EE3 RECORD_LAYOUT__2 0 COMPU_METHOD__14 0 255 /begin FUNCTION_LIST FaultManager /end FUNCTION_LIST /end CHARACTERISTIC
/begin CHARACTERISTIC TPS_InputLow_FaultOperation "Calibration for testing fault." VALUE 0x80037EF7 RECORD_LAYOUT__2 0 COMPU_METHOD__16 0 8 /begin FUNCTION_LIST FaultManager /end FUNCTION_LIST /end CHARACTERISTIC
/begin CHARACTERISTIC TPS_InputLow_X_Limit "Limit threshold for X." VALUE 0x80037EB8 RECORD_LAYOUT__3 0 COMPU_METHOD__7 0 4294967295 /begin FUNCTION_LIST FaultManager /end FUNCTION_LIST /end CHARACTERISTIC
/begin CHARACTERISTIC TPS_InputLow_Y_Limit "Limit threshold for Y." VALUE 0x80037EBC RECORD_LAYOUT__3 0 COMPU_METHOD__7 0 4294967295 /begin FUNCTION_LIST FaultManager /end FUNCTION_LIST /end CHARACTERISTIC
/begin CHARACTERISTIC TPS_InputLowThresh "Input out of range low point threshold" VALUE 0x80037EB4 RECORD_LAYOUT__1 0 COMPU_METHOD__3 -1E+17 1E+17 /begin FUNCTION_LIST Subsystem1 /end FUNCTION_LIST /end CHARACTERISTIC
/begin CHARACTERISTIC TPS_OvrSts "Controls status of value override." VALUE 0x80037E64 RECORD_LAYOUT__2 0 COMPU_METHOD__6 0 255 /begin FUNCTION_LIST Override_2_ /end FUNCTION_LIST /end CHARACTERISTIC
/begin CHARACTERISTIC TPS_OvrVal "" VALUE 0x80037E60 RECORD_LAYOUT__1 0 COMPU_METHOD__5 -1E+17 1E+17 /begin FUNCTION_LIST Override_2_ /end FUNCTION_LIST /end CHARACTERISTIC
/begin FUNCTION Diagnostics "Diagnostics" /begin SUB_FUNCTION PowerUp_Down /end SUB_FUNCTION /end FUNCTION
/begin FUNCTION PowerUp_Down "PowerUp_Down" /end FUNCTION
/begin FUNCTION System "System" /begin SUB_FUNCTION CAN FaultManager Platform XCP /end SUB_FUNCTION /end FUNCTION
/begin FUNCTION CAN "CAN" /end FUNCTION
/begin FUNCTION FaultManager "FaultManager" /end FUNCTION
/begin FUNCTION Platform "Platform" /begin SUB_FUNCTION EngineConfig /end SUB_FUNCTION /end FUNCTION
/begin FUNCTION EngineConfig "EngineConfig" /begin SUB_FUNCTION Fuel /end SUB_FUNCTION /end FUNCTION
/begin FUNCTION Fuel "Fuel" /end FUNCTION
/begin FUNCTION XCP "XCP" /end FUNCTION
/begin FUNCTION Training "Training" /begin SUB_FUNCTION Foreground /end SUB_FUNCTION /end FUNCTION
/begin FUNCTION Foreground "Foreground" /begin SUB_FUNCTION Actuators Sensors /end SUB_FUNCTION /end FUNCTION
/begin FUNCTION Actuators "Actuators" /begin SUB_FUNCTION Override /end SUB_FUNCTION /end FUNCTION
/begin FUNCTION Override "Override" /end FUNCTION
/begin FUNCTION Sensors "Sensors" /begin SUB_FUNCTION Subsystem Subsystem1 /end SUB_FUNCTION /end FUNCTION
/begin FUNCTION Subsystem "Subsystem" /begin SUB_FUNCTION Override_1_ /end SUB_FUNCTION /end FUNCTION
/begin FUNCTION Override_1_ "Override" /end FUNCTION
/begin FUNCTION Subsystem1 "Subsystem1" /begin SUB_FUNCTION Override_2_ /end SUB_FUNCTION /end FUNCTION
/begin FUNCTION Override_2_ "Override" /end FUNCTION
/begin USER_RIGHTS Access1 /begin REF_GROUP GroupAccess1 /end REF_GROUP /end USER_RIGHTS
/begin USER_RIGHTS Access4 /begin REF_GROUP GroupAccess4 /end REF_GROUP /end USER_RIGHTS
/begin GROUP GroupAccess1
 /begin REF_CHARACTERISTIC KeySwHiTimeThr KeySwLoTimeThr APP_DefaultValue TPS_DefaultValue PWM_Enable ETC_DC_OvrVal ETC_DC_OvrSts PWM_Freq APP_ADC_OvrVal APP_ADC_OvrSts APP_InputHighThresh APP_InputHi_X_Limit APP_InputHi_Y_Limit APP_InputLowThresh APP_InputLow_X_Limit APP_InputLow_Y_Limit APP_ADCHiPT APP_ADCLoPT APP_OvrVal APP_OvrSts TPS_ADC_OvrVal TPS_ADC_OvrSts TPS_InputHighThresh TPS_InputHi_X_Limit TPS_InputHi_Y_Limit TPS_InputLowThresh TPS_InputLow_X_Limit TPS_InputLow_Y_Limit TPS_ADCHiPT TPS_ADCLoPT TPS_OvrVal TPS_OvrSts CAN1__XCP_BC_ID CAN1__XCP_RX_ID CAN1__XCP_TX_ID ModelName BuildNumber MatlabVersion RaptorVersion SwIdTxt CalIdTxt BuildUID IdTableRev HardwareType DateStamp INPUT29_ADCMon_HoldCount CAN1__XCP_Security CAN1_Startup_Delay CAN1_ErrorCheck_Interval CAN1_ErrorPassive_Delay SyC_tiPostDrvMax_C SyC_tiPostDrvMin_C SyC_tiPostDrvResv_C InjCDrv_EndOfStart EndOfStart /end REF_CHARACTERISTIC
 /begin REF_MEASUREMENT FgndTasksStopped KeySw_Bgnd KeepModuleOn ETC_DC APP_ADC APPHighProbe APPLowProbe APP TPS_ADC TPSHighProbe TPSLowProbe TPS CAN1_CANTX_QueueOverrun CAN1_CANTX_QueueCount CAN1_CANTX_QueueMax CAN1_CANRX_QueueOverrun CAN1_CANRX_QueueCount CAN1_CANRX_QueueMax Reset_xHistBuf OCWDA_stWDAPtt ResetReason ResetGroupId B_pwf NumberOfResetsSincePowerOnReset ContextSaveAreaSize SystemStackSize UserStackSize MaxContextSaveAreaSize MaxSystemStackSize MaxUserStackSize EEPROM_State /end REF_MEASUREMENT
/end GROUP
/begin GROUP GroupAccess4
 /begin REF_CHARACTERISTIC APP_InputHi_Action_0_State APP_InputHi_Action_0 APP_InputHi_Action_1_State APP_InputHi_Action_1 APP_InputLow_Action_0_State APP_InputLow_Action_0 APP_InputLow_Action_1_State APP_InputLow_Action_1 TPS_InputHi_Action_0_State TPS_InputHi_Action_0 TPS_InputHi_Action_1_State TPS_InputHi_Action_1 TPS_InputLow_Action_0_State TPS_InputLow_Action_0 TPS_InputLow_Action_1_State TPS_InputLow_Action_1 APP_InputHi_FaultOperation APP_InputLow_FaultOperation TPS_InputHi_FaultOperation TPS_InputLow_FaultOperation /end REF_CHARACTERISTIC
 /begin REF_MEASUREMENT Delta_Time Absolute_Time /end REF_MEASUREMENT
/end GROUP
/end MODULE
/end PROJECT
